## platform/bcm6756_11ax_nor_release/kpatch/bsp/Kconfig
```kconfig
menuconfig TENDA_PRIVATE_BSP
    depends on TENDA_PRIVATE
    bool "Tenda Private bsp modules"
    default y

config SWITCH_BCM
    depends on TENDA_PRIVATE_BSP
    bool "support SWITCH_BCM"
    default n
	
config PHY_YT8531_SUPPORT
    depends on TENDA_PRIVATE_BSP
    bool "support PHY_YT8531"
    default n
	
config PHY_TRX_DELAY_SUPPORT
    depends on TENDA_PRIVATE_BSP
    bool "support adjust phy trx delay"
    default n

config MTD_PARTITION_LOCK
    depends on TENDA_PRIVATE_BSP
    bool "support mtd partition lock and unlock"
    default n

config FLASH_LOCK_SUPPORT
    depends on TENDA_PRIVATE_BSP
    bool "support flash lock and unlock"
    default n

config WRITE_SR_ENABLE
    depends on FLASH_LOCK_SUPPORT
    bool "support write sr enable"
    default n
    
config VFS_LOCK_SUPPORT
    depends on TENDA_PRIVATE_BSP
    bool "support vfs lock and unlock"
    default n

config SUPPORT_CUSTOM_USB_LED
    depends on TENDA_PRIVATE_BSP
	bool "support Tenda USB LED driver"
	default n
	---help---
	  Say 'y' here if you want to connect an USBLED device to your

config CUSTOM_USB_LED_INDEX
	int "Tenda USB LED INDEX"
	default 4
	depends on SUPPORT_CUSTOM_USB_LED

config PICTURE_MTD_SUPPORT
    depends on TENDA_PRIVATE_BSP
    bool "support weiqi picture mtd"
    default n

config PICTURE_MTD_SIZE
    depends on PICTURE_MTD_SUPPORT
    hex "picture mtd size"
    default "0x80000"
	
config UGW_DUAL_IMAGE_ENABLE
	depends on TENDA_PRIVATE_BSP
	bool "support dual image"
	default n
	
config TENDA_SF19A28_PORTPING
    depends on TENDA_PRIVATE_BSP
    bool "support set port tx rx delay"
    default n
```

## platform/bcm6756_11ax_nor_release/kpatch/wifi/Kconfig
```kconfig
menuconfig TENDA_PRIVATE_WLAN
    depends on TENDA_PRIVATE
    bool "Tenda Private wlan modules"
    default y

config TENDA_WLAN_REPEATER
    depends on TENDA_PRIVATE_WLAN
    bool "Support wisp and apclient"
    default y

config TENDA_WLAN_TUNNEL
    depends on TENDA_PRIVATE_WLAN
    bool "Support TUNNEL"
    default n

config TENDA_WLAN_TDMA
    depends on TENDA_PRIVATE_WLAN
    bool "Support TDMA"
    default n

config TENDA_WLAN_PREBE_LIMIT
    depends on TENDA_PRIVATE_WLAN
    bool "Support probe broadcast limit"
    default y

config TENDA_WLAN_RSSI_LIMIT
    depends on TENDA_PRIVATE_WLAN
    bool "Support rssi limit"
    default n

config TENDA_WLAN_ED_LOWBOUND_AVOID
    depends on TENDA_PRIVATE_WLAN
    bool "Support EDCCA lowbound abnormal avoid"
    default n

config TENDA_ADAPTVTY_CONTROL
    depends on TENDA_PRIVATE_WLAN
    bool "Support adaptivity control"
    default n

config TENDA_UCC_CONTROL
    depends on TENDA_PRIVATE_WLAN
    bool "Support Uniform country code"
    default n

config TENDA_STA_REPORT
    depends on TENDA_PRIVATE_WLAN
    bool "Support sta report"
    default y

config TENDA_WLAN_NODE_ROAMING
    depends on TENDA_PRIVATE_WLAN
    bool "Support Node roaming"
    default y

config TENDA_XMESH_HB_ENABLE
    depends on TENDA_PRIVATE_WLAN
    bool "Support xmesh heartbeat"
    default n

config TENDA_REPEATER_STATUS
    depends on TENDA_PRIVATE_WLAN
    bool "Support repeater status"
    default n

config TENDA_FOLLOW_NETTYPE
    depends on TENDA_PRIVATE_WLAN
    bool "Support repeater follow nettype"
    default y

config TENDA_SCAN_PRIORITY
    depends on TENDA_PRIVATE_WLAN
    bool "Support repeater scan priority"
    default y

config TENDA_WLAN_AUTOHIDE_SSID
    depends on TENDA_PRIVATE_WLAN
    bool "Support autohide SSID"
    default n

config TENDA_WLAN_ZIP_IMAGE
    depends on TENDA_PRIVATE_WLAN
    bool "Support to zip wireless modules"
    default n
    
config TENDA_WRITE_CFM_FILE
    depends on TENDA_PRIVATE_WLAN
    bool "Support write to file"
    default n

config TENDA_DFS_EVADE_DEFAULT
    depends on TENDA_PRIVATE_WLAN
    bool "support radar evade to band1 for Tenda repeater product whose chanlist is band1 defaultly "
    default n

config COUNTRY_SPEC_FULLSCAN
    depends on TENDA_PRIVATE_WLAN
    bool "Set US/1 as a spec_region for repeaters of Tenda to do full_channel_scan"
    default n

config TENDA_WLAN_WL_DEBUG_MINI
    depends on TENDA_PRIVATE_WLAN
    bool "Support WL Debug only error assoc and scan..."
    default n

config PRIVATE_IE_ENCRYPT
    depends on TENDA_PRIVATE_WLAN
    bool "Support private ie encryption and decryption"
    default n
config TENDA_GAME_SPEEDUP
     depends on TENDA_PRIVATE_WLAN
     bool "Support speed up tencent game data TX"
     default n

config TENDA_WLAN_COUNTRY_DIV_CHANNEL
    depends on TENDA_PRIVATE_WLAN
    bool "In the country code, the 5G channel is divided into high and low channels"
    default n
config TENDA_DFS_SUPPORT
    depends on TENDA_PRIVATE_WLAN
    bool "Support DFS channel"
    default n
```

## targets/ax12_pro_nor/obj/binaries/brcm_full_linux.its
```
/*
 * Copyright (C) 2017 Rockchip Electronic Co.,Ltd
 * Copyright (C) 2019 Broadcom
 *
 * Simple U-boot fit source file containing U-Boot, dtb and optee
 */

/dts-v1/;

/ {
	description = "Simple image with ATF and optional OP-TEE support";
	#address-cells = <1>;
	ident_1 = "@(#) $imageversion: 5042GW0061432 $";
	ident_2 = "@(#) $imageversion: 5042GW0061432 $";
	ident_3 = "@(#) $imgversion: 5.04L.02 $";
	ident_4 = "@(#) $imgversion: 5.04L.02 $";


	images {


		fdt_uboot {
			description = "dtb";
			data = /incbin/("../../obj/uboot/dts/dt.dtb");
			type = "flat_dt";
			compression = "none";
			hash-1 {
				algo = "sha256";
			};
		};

		kernel {
			description = "4.19 kernel";
			data = /incbin/("../../obj/uboot/vmlinux.bin.lzma");
			type = "kernel";
			os = "linux";
			arch = "arm";
			compression = "lzma";
			load = <0x108000>;
			entry = <0x108000>;
			hash-1 {
				algo = "sha256";
			};
		};

		fdt_96756 {
			description = "dtb";
			data = /incbin/("/HomeCoverage20231207/targets/ax12_pro_nor/obj/binaries/linux/96756.dtb");
			arch = "arm";
			type = "flat_dt";
			compression = "none";
			hash-1 {
				algo = "sha256";
				value = [0000000000000000000000000000000000000000000000000000000000000000];
			};
		};
       

		fdt_96756REF1 {
			description = "dtb";
			data = /incbin/("/HomeCoverage20231207/targets/ax12_pro_nor/obj/binaries/linux/96756REF1.dtb");
			arch = "arm";
			type = "flat_dt";
			compression = "none";
			hash-1 {
				algo = "sha256";
				value = [0000000000000000000000000000000000000000000000000000000000000000];
			};
		};
       

		fdt_96756REF1_SG {
			description = "dtb";
			data = /incbin/("/HomeCoverage20231207/targets/ax12_pro_nor/obj/binaries/linux/96756REF1_SG.dtb");
			arch = "arm";
			type = "flat_dt";
			compression = "none";
			hash-1 {
				algo = "sha256";
				value = [0000000000000000000000000000000000000000000000000000000000000000];
			};
		};
       

	};
	configurations {
		default = "conf_uboot";
		conf_uboot {
			description = "BRCM 63xxx with uboot";
			fdt = "fdt_uboot";
			loadables = "atf","uboot";
		};
	
		conf_linux {
			description = "BRCM 63xxx linux";
			kernel = "kernel";
			fdt = "fdt_96756";
		};

		conf_lx_96756 {
			description = "BRCM 63xxx linux";
			kernel = "kernel";
			fdt = "fdt_96756";
		};
	
		conf_ub_96756 {
			description = "96756";
			fdt = "fdt_96756";
			loadables = "atf","uboot";
		};
        

		conf_lx_96756REF1 {
			description = "BRCM 63xxx linux";
			kernel = "kernel";
			fdt = "fdt_96756REF1";
		};
	
		conf_ub_96756REF1 {
			description = "96756REF1";
			fdt = "fdt_96756REF1";
			loadables = "atf","uboot";
		};
        

		conf_lx_96756REF1_SG {
			description = "BRCM 63xxx linux";
			kernel = "kernel";
			fdt = "fdt_96756REF1_SG";
		};
	
		conf_ub_96756REF1_SG {
			description = "96756REF1_SG";
			fdt = "fdt_96756REF1_SG";
			loadables = "atf","uboot";
		};
        


	};
};
```
